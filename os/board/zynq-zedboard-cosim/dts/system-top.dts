/*
 * CAUTION: This file is automatically generated by Xilinx.
 * Version: HSI 2019.1
 * Today is: Fri Aug  6 15:26:34 2021
 */


/dts-v1/;
#include "zynq-7000.dtsi"
#include "zedboard.dtsi"
#include "pcw.dtsi"
#include "zynq-pl-remoteport.dtsi"
/ {
	chosen {
		bootargs = "earlycon";
		stdout-path = "serial0:115200n8";
	};
	aliases {
		ethernet0 = &gem0;
		serial0 = &uart1;
		spi0 = &qspi;
	};
	memory {
		device_type = "memory";
		reg = <0x0 0x20000000>;
	};
};
