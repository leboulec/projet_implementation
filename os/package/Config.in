## os/package/Config.in
```kconfig
source "$BR2_EXTERNAL_IMPL_PATH/package/axi-dma-driver/Config.in"
source "$BR2_EXTERNAL_IMPL_PATH/package/axi-dma-api/Config.in"
```

## os/package/custom_drivers/Config.in
```kconfig
config BR2_PACKAGE_CUSTOM_DRIVERS
  bool "custom drivers"
  depends on BR2_LINUX_KERNEL
  help
    Les drivers que l'on a ecrit
```

## os/package/zynq-mkbootimage/Config.in.host
```kconfig
config BR2_PACKAGE_HOST_ZYNQ_MKBOOTIMAGE
  bool "host zynq-mkbootimage"
  help
    Boot image generation tool for Zynq-7000 and ZynqMP-Soc
```
